## Documentation/devicetree/bindings/sound/hw-params-rules.txt
```
HW-params-rules:

Rules that execute actions during hw-params method calls.

The following optional nodes will sit inside the sound card nodes:

hw-params-rule subnodes:

contains further subnodes:

- match:  list of matches that have to apply
- action: list of actions to execute

match and action subnodes:

Required properties:

- method: the method name (string) to execute

required/optional depend on the method defined above, typical properies

Required values for methods:
* asoc_generic_hw_params_match_sample_bits
* asoc_generic_hw_params_match_rate
* asoc_generic_hw_params_match_channel
* asoc_generic_hw_params_set_fixed_bclk_size

- value: u32 value to pass to method.
- values: u32 value array to pass to method.

Example:
sound {
	compatible = "simple-audio-card";
	...
	/*
	 * set bclk_size to 80 when encountering:
	 * 48kHz or 96kHz with 2 channels with 32bit/channel
	 */
	hw-params-rule@0 {
		match@0 {
			method = "asoc_generic_hw_params_match_sample_bits";
			values = <32>;
		};
		match@1 {
			method = "asoc_generic_hw_params_match_rate";
			values = <48000>, <96000>;
		};
		match@2 {
			method = "asoc_generic_hw_params_match_channels";
			values = <2>;
		};
		action@0 {
			method = "asoc_generic_hw_params_set_fixed_bclk_size";
			value = <80>;
		};
	};
	/*
	 * set bclk_size to 40 when encountering:
	 * 48kHz with 2 channels with 16bit/channel
	 */
	hw-params-rule@0 {
		match@0 {
			method = "asoc_generic_hw_params_match_sample_bits";
			values = <16>;
		};
		match@1 {
			method = "asoc_generic_hw_params_match_rate";
			values = <48000>;
		};
		match@2 {
			method = "asoc_generic_hw_params_match_channels";
			values = <2>;
		};
		action@0 {
			method = "asoc_generic_hw_params_set_fixed_bclk_size";
			value = <40>;
		};
	};
};
```

## sound/soc/generic/Kconfig
```kconfig
config SND_HW_PARAMS_RULES
	tristate "ASoC hw_param rules support"
	depends on OF
	help
	  This option enables generic hw_param_rules support

config SND_SIMPLE_CARD
	tristate "ASoC Simple sound card support"
	help
	  This option enables generic simple sound card support
```
